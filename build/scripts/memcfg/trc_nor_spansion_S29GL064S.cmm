;
; Setup FSMC with good values
;

; Values for Spansion S29GL064S
D.S UD:(&fsmcregbase+0x0) %LE %LONG 0x000010d9
D.S UD:(&fsmcregbase+0x4) %LE %LONG 0x00000301

flash.reset
; CFI query does not work for this flash
;flash.cfi &fsmcmembase word /target (&itcmbase)++0x7fff (&dtcmbase)++0x7fff
flash.create 1. (&fsmcmembase+0x000000)--(&fsmcmembase+0x00ffff) 0x2000 TARGET word
flash.create 1. (&fsmcmembase+0x010000)--(&fsmcmembase+0x7fffff) 0x10000 TARGET word
flash.target C:(&itcmbase)++0x7fff C:(&dtcmbase)++0x7fff ~~/demo/arm/flash/word/am29m256.bin
