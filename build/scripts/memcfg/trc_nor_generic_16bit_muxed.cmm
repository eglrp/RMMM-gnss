;
; Setup FSMC with good values
;

; Values for generic muxed 16bit memory
D.S UD:(&fsmcregbase+0x0) %LE %LONG 0x000010db
D.S UD:(&fsmcregbase+0x4) %LE %LONG 0x00000201

flash.reset
flash.cfi &fsmcmembase word /target (&itcmbase)++0x7fff (&dtcmbase)++0x7fff
