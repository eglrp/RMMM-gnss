;
; Setup FSMC with good values
;
; Value for generic RAM 16bit not muxed
D.S UD:(&fsmcregbase+0x8) %LE %LONG 0x000010d1
D.S UD:(&fsmcregbase+0xc) %LE %LONG 0x00000404

R.S PC (&fsmcmembase+0x4000000)
