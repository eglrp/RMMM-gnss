;
; Setup FSMC with good values
;

; Values for Winbond W29GL064C
D.S UD:(&fsmcregbase+0x0) %LE %LONG 0x000010d9
D.S UD:(&fsmcregbase+0x4) %LE %LONG 0x00000300

flash.reset
flash.cfi &fsmcmembase word /target (&itcmbase)++0x7fff (&dtcmbase)++0x7fff
