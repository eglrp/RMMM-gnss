;
; Setup FSMC with good values
;

; Values for Spansion S71VS064R
D.S UD:(&fsmcregbase+0x0) %LE %LONG 0x000030db
D.S UD:(&fsmcregbase+0x4) %LE %LONG 0x01000511

flash.reset
flash.cfi &fsmcmembase word /target (&itcmbase)++0x7fff (&dtcmbase)++0x7fff
flash.target C:(&itcmbase)++0x7fff C:(&dtcmbase)++0x7fff ~~/demo/arm/flash/word/am29n256.bin
