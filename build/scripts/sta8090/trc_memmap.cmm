;
; MACROS for memory map of Teseo3
;
pmacro.reset

GLOBAL &itcmbase
GLOBAL &dtcmbase
GLOBAL &prccbckbase
GLOBAL &prccbase
GLOBAL &fsmcregbase
GLOBAL &fsmcmembase
GLOBAL &sqiregbase
GLOBAL &sqimembase

&itcmbase=0x0
&dtcmbase=0x100000
&prccbckbase=0x51000000
&prccbase=0x5200F000
&fsmcregbase=0x50020000
&fsmcmembase=0x20000000
&sqiregbase=0x50010100
&sqimembase=0x10000000
