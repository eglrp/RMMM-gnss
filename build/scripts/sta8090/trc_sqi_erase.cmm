Entry &sqi_start_addr &sqi_size

do trc_reset.cmm true sqi false

;
; Configure ITCM for flash algorithm
;
PER.Set C15:0x001 %Long 0x00050078    ;disable cache & MPU, enable TCMs

PER.Set C15:0x019 %Long 0x00100012    ;set DTCM size and location
PER.Set C15:0x119 %Long 0x00000012    ;set ITCM size

D.S SD:(&prccbase+0x10) %LE %LONG 0xF

;
; Load and execute software to reset SQI flash memory
;
break.delete /all
data.load.elf sqi_reset.axf
break.set _sys_exit
register.set pc 0x0
register.set cpsr 0xd3
go
wait !run()

;
; Init image position and size from binary
;
&dest_offset=&sqi_start_addr-0x10000000
&buf_pos=0
&buf_size=&sqi_size

;
; Load sqi_loader
;
break.delete /all
data.load.elf sqi_loader.axf
break.set _sys_exit

;
; Copy binary to flash in chunks of 0x10000 bytes
;
WHILE &buf_pos<&buf_size
(
  d.s SD:(&dtcmbase+0xff8) %LE %LONG &dest_offset
  d.s SD:(&dtcmbase+0xffc) %LE %LONG 0x10000
  ;data.set 0x00101000--0x00110fff %LONG 0xffffffff
  data.set (&dtcmbase+0x1000)++0xffff %LONG 0xffffffff

  register.set pc 0x0
  register.set cpsr 0xd3
  go
  wait !run()

  &buf_pos=&buf_pos+0x10000
  &dest_offset=&dest_offset+0x10000
)

print "Erase completed successfully"
wait 500ms
