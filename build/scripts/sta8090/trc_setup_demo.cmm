menu.rp
(
  add
  menu
  (
    popup "STA8090 GNSSapp Targets"
    (
      popup "Demo images"
      (
        menuitem "Flash gpOS examples SoC SQI" "do trc_sqi_flasher.cmm ..\..\..\bin\sta8090_gpOS_soc_sqi_os20_rvct.bin ..\..\..\bin\sta8090_gpOS_soc_sqi_os20_rvct.axf"
        menuitem "Flash GNSS demo FR GAE SoC SQI(SQI)" "do trc_sqi_flasher.cmm ..\..\..\bin\sta8090_gnssapp_demo_soc_sqi_sqi_fr_gae.bin ..\..\..\bin\sta8090_gnssapp_demo_soc_sqi_sqi_fr_gae.elf"
        menuitem "Flash GNSS demo gpOS RVCT SoC SQI(SQI)" "do trc_sqi_flasher.cmm ..\..\..\bin\sta8090_gnssapp_demo_soc_sqi_sqi_os20_rvct.bin ..\..\..\bin\sta8090_gnssapp_demo_soc_sqi_sqi_os20_rvct.axf"
      )
    )
  )
)
