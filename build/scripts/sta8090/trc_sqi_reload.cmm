Entry &filename

do trc_reset.cmm true sqi false

; Enable SQI
per.set.field d:(&prccbase+0x40) %LONG 0x00000004 1.
per.set.field d:(&prccbase+0x44) %LONG 0x00000004 1.

b.sel program onchip

if "&filename"!=""
(
  ; Reset and load executable image
  data.load.elf &filename /nocode
  R.S PC v.value(&reset_vector)
)
else
(
  R.S PC &sqimembase
)

r.s CPSR 0xd3

do trc_openwins.cmm