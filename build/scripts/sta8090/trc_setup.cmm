winclear
;Add some extra buttons to the toolbar
menu.reset

do ~~\t32.cmm

menu.reprogram ..\memcfg\trc_memmenu.cmm
menu.rp
(
  add
  menu
  (
    popup "STA8090 GNSSapp Targets"
    (
      popup "OS20 RVCT"
      (
        menuitem "Reload SoC RAM(RAM) target" "do trc_ram_program.cmm ..\..\..\bin\sta8090_gnssapp_soc_ram_ram_os20_rvct.axf"
        menuitem "Flash SoC NOR(NOR) target" "do trc_nor_flasher.cmm program ..\..\..\bin\sta8090_gnssapp_soc_nor_nor_os20_rvct.axf"
        menuitem "Flash SoC SQI(SQI) target" "do trc_sqi_flasher.cmm ..\..\..\bin\sta8090_gnssapp_soc_sqi_sqi_os20_rvct.bin ..\..\..\bin\sta8090_gnssapp_soc_sqi_sqi_os20_rvct.axf"
        separator
        menuitem "Flash SAL SQI(SQI) target" "do trc_sqi_flasher.cmm ..\..\..\bin\sta8090_gnssapp_sal_sqi_sqi_os20_rvct.bin ..\..\..\bin\sta8090_gnssapp_sal_sqi_sqi_os20_rvct.axf"
      )
      popup "FreeRTOS RVCT"
      (
        menuitem "Flash SQI(SQI) target" "do trc_sqi_flasher.cmm ..\..\..\bin\sta8090_gnssapp_soc_sqi_sqi_fr_rvct.bin ..\..\..\bin\sta8090_gnssapp_soc_sqi_sqi_fr_rvct.axf"
      )
      popup "FreeRTOS GAE"
      (
        menuitem "Reload RAM(RAM) target" "do trc_ram_program.cmm ..\..\..\bin\sta8090_gnssapp_soc_ram_ram_fr_gae.elf"
        menuitem "Flash NOR(NOR) target" "do trc_nor_flasher.cmm program ..\..\..\bin\sta8090_gnssapp_soc_nor_nor_fr_gae.elf"
        menuitem "Flash SQI(SQI) target" "do trc_sqi_flasher.cmm ..\..\..\bin\sta8090_gnssapp_soc_sqi_sqi_fr_gae.bin ..\..\..\bin\sta8090_gnssapp_soc_sqi_sqi_fr_gae.elf"
        separator
        menuitem "Flash SAL SQI(SQI) target" "do trc_sqi_flasher.cmm ..\..\..\bin\sta8090_gnssapp_sal_sqi_sqi_fr_gae.bin ..\..\..\bin\sta8090_gnssapp_sal_sqi_sqi_fr_gae.elf"
      )
    )
  )
  add
  toolbar
  (
    toolitem "Store context" "[:save]" "STOre currwin.cmm win break"
    toolitem "Load context" "[:load]" "do currwin.cmm"
    separator
    toolitem "Show peripherals" "PV" "PER.View"
    separator
    toolitem "Attach and restart RAM image" "RR" "do trc_ram_reload.cmm"
    toolitem "Attach and restart NOR image" "NR" "do trc_nor_reload.cmm"
    toolitem "Attach and restart SQI image" "SR" "do trc_sqi_reload.cmm"
    separator
    toolitem "Attach to target" "AT" "do trc_attach.cmm"
    toolitem "Reset windows" "RW" "do trc_openwins.cmm"
  )
)
;
; if DR menu exist, run it
;
if os.file(trc_setup_dr.cmm)
do .\trc_setup_dr.cmm

;
; if Demo menu exist, run it
;
if os.file(trc_setup_demo.cmm)
do .\trc_setup_demo.cmm

;
; if Testsuite menu exist, run it
;
if os.file(trc_setup_testsuite.cmm)
do .\trc_setup_testsuite.cmm

; Start debug
Mode.HLL

; Prepare gneeric nor and ram setup
copy ..\memcfg\trc_nor_generic_16bit_muxed.cmm trc_nor_selected_cfg.cmm
copy ..\memcfg\trc_ram_generic_16bit_muxed.cmm trc_ram_selected_cfg.cmm

; Setup global macros for T3 memory map
do trc_memmap.cmm

dialog.ok "If FSMC is needed, remember to set NOR and/or RAM from Memory pulldown menu"

enddo
