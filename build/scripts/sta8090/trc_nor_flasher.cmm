Entry &oper &param

do trc_reset.cmm true nor false

;
; Configure ITCM for flash algorithm
;
PER.Set C15:0x001 %Long 0x00050078    ;disable cache & MPU, enable TCMs

PER.Set C15:0x019 %Long 0x00100012    ;set DTCM size and location
PER.Set C15:0x119 %Long 0x00000012    ;set ITCM size

D.S SD:(&prccbase+0x10) %LE %LONG 0xF

;
; Reset FSMC
;
per.set.field d:(&prccbase+0x44) %LONG 0x08000000 0.
per.set.field d:(&prccbase+0x40) %LONG 0x08000000 0.
wait 1ms
per.set.field d:(&prccbase+0x40) %LONG 0x08000000 1.
per.set.field d:(&prccbase+0x44) %LONG 0x08000000 1.
wait 1ms

;
; Setup FSMC with selected values
;
do trc_nor_selected_cfg.cmm

if "&oper"=="erase"
(
  print "Erasing..."
  wait 500ms
  flash.unlock &param
  flash.erase &param
  flash.lock &param
  print "Flash erase completed successfully"
  wait 500ms

  do trc_reset.cmm true nor false
)
else
(
  if "&param"!=""
  (
    flash.unlock (&fsmcmembase)++0xfffff
    flash.erase (&fsmcmembase)++0xfffff
    flash.program (&fsmcmembase)++0xfffff
    print "Programming flash"
    wait 500ms
    data.load &param /word
    flash.program off
    flash.lock (&fsmcmembase)++0xfffff
    flash.reset

    ; verify the FLASH contents
    print "Verifying flash"
    wait 500ms
    data.load &param /diff
    if found()
    (
      print "Verify error after flash programming"
      enddo
    )
    else
    (
      print "Flash programming completed successfully"
      wait 500ms
    )
  )

  do trc_nor_reload.cmm &param
)

