Entry &bin_filename &axf_filename

do trc_reset.cmm true sqi false

;
; Configure ITCM for flash algorithm
;
PER.Set C15:0x001 %Long 0x00050078    ;disable cache & MPU, enable TCMs

PER.Set C15:0x019 %Long 0x00100012    ;set DTCM size and location
PER.Set C15:0x119 %Long 0x00000012    ;set ITCM size

D.S SD:(&prccbase+0x10) %LE %LONG 0xF

if "&axf_filename"!=""
(
  ;
  ; Load and execute software to reset SQI flash memory
  ;
  break.delete /all
  data.load.elf sqi_reset.axf
  break.set _sys_exit
  register.set pc 0x0
  register.set cpsr 0xd3
  go
  wait !run()

  ;
  ; Get destination start address from axf symbols and evaluate offset
  ;
  data.load.elf &axf_filename /nocode
  &dest_addr=v.value(&reset_vector)
  &dest_offset=&dest_addr-&sqimembase

  ;
  ; Init image position and size from binary
  ;
  &buf_pos=0
  &buf_size=OS.FILE.SIZE(&bin_filename)

  ;
  ; Load sqi_loader
  ;
  break.delete /all
  data.load.elf sqi_loader.axf
  break.set _sys_exit

  ;
  ; Copy binary to flash in chunks of 0x10000 bytes
  ;
  WHILE &buf_pos<&buf_size
  (
    d.s SD:(&dtcmbase+0xff8) %LE %LONG &dest_offset
    d.s SD:(&dtcmbase+0xffc) %LE %LONG 0x10000
    DATA.LOAD.BINARY &bin_filename (&dtcmbase+0x1000)++0xffff /nosymbol /SKIP &buf_pos

    register.set pc 0x0
    register.set cpsr 0xd3
    go
    wait !run()

    &buf_pos=&buf_pos+0x10000
    &dest_offset=&dest_offset+0x10000
  )

  ; verify the FLASH contents
  print "Verifying flash"
  wait 500ms
  data.load &axf_filename /diff
  if found()
  (
    print "Verify error after flash programming"
    enddo
  )
  else
  (
    print "Flash programming completed successfully"
    wait 500ms
  )
)

do trc_sqi_reload.cmm &axf_filename
