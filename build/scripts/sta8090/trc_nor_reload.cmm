Entry &filename

do trc_reset.cmm true nor true

; Enable FSMC
per.set.field d:(&prccbase+0x40) %LONG 0x08000000 1.
per.set.field d:(&prccbase+0x44) %LONG 0x08000000 1.

b.sel program onchip

R.S PC &fsmcmembase
r.s CPSR 0xd3

if "&filename"!=""
(
  ; Reset and load executable image
  data.load.elf &filename /nocode
)

do trc_openwins.cmm
