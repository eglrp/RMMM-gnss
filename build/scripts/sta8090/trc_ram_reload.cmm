Entry &filename

do trc_reset.cmm true ram true

; Enable FSMC
per.set.field d:(&prccbase+0x40) %LONG 0x08000000 1.
per.set.field d:(&prccbase+0x44) %LONG 0x08000000 1.

b.sel program auto

;
; Setup FSMC with good values
;
do trc_ram_selected_cfg.cmm

R.S PC (&fsmcmembase+0x4000000)
r.s CPSR 0xd3

if "&filename"!=""
(
  ; Reset and load executable image
  data.load.elf &filename /nocode
)

do trc_openwins.cmm
