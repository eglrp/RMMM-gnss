Entry &resetarm &loadrgn &resetclk
;
; Basic resets
;
winpage.reset
break.delete /all
Mmu.reset
SYStem.ReSet
SYStem.Down
;
; Configure PLLs from ARM9
;
System.MC.IRPRE 0
System.MC.DRPRE 0
SYStem.jtagClock 400kHz
System.MC.IRPOST 0x0
System.MC.DRPOST 0x0
SYStem.CPU ARM946E
SYSTEM.Option EnReset OFF
SYSTEM.Option ResBreak OFF
SYSTEM.Option TRST OFF
SYSTEM.Option ShowError OFF
SYSTEM.Option WaitReset OFF
tronchip.set swi off
SYStem.Up

if "&resetarm"=="true"
(
  target.resetout
  register.reset

  print "Resetting ARM..."
  ;
  ; Reset Teseo2
  ;
  per.set.field d:(&prccbase+0x44) %LONG 0x1 1.
  wait 50ms
  per.set.field d:(&prccbase+0x44) %LONG 0x1 0.
  wait 50ms
  per.set.field d:(&prccbase+0x44) %LONG 0x1 1.

  ;
  ; Reset memories
  ;
  per.set.field d:(&prccbase+0x40) %LONG 0x08000004 0xffffffff
  per.set.field d:(&prccbase+0x44) %LONG 0x08000004 0x0
  wait 1ms
  per.set.field d:(&prccbase+0x44) %LONG 0x08000004 0xffffffff
  wait 1ms

  ;
  ; Enable TCMs and disable caches
  ;
  PER.Set C15:0x4a7 %Long 0x00000000    ;drain write buffer
  PER.Set C15:0x057 %Long 0x00000000    ;flush instruction cache
  PER.Set C15:0x067 %Long 0x00000000    ;flush data cache

  PER.Set C15:0x002 %Long 0x00000000    ;reset data cache
  PER.Set C15:0x102 %Long 0x00000000    ;reset instruction cache
  PER.Set C15:0x003 %Long 0x00000000    ;reset write buffer
  PER.Set C15:0x205 %Long 0x00000000    ;disable data protection bits for all areas
  PER.Set C15:0x305 %Long 0x00000000    ;disable instruction protection bits for all areas
  PER.Set C15:0x006 %Long 0x00000000    ;reset region 0
  PER.Set C15:0x016 %Long 0x00000000    ;reset region 1
  PER.Set C15:0x026 %Long 0x00000000    ;reset region 2
  PER.Set C15:0x036 %Long 0x00000000    ;reset region 3
  PER.Set C15:0x046 %Long 0x00000000    ;reset region 4
  PER.Set C15:0x056 %Long 0x00000000    ;reset region 5
  PER.Set C15:0x066 %Long 0x00000000    ;reset region 6
  PER.Set C15:0x076 %Long 0x00000000    ;reset region 7

  PER.Set C15:0x001 %Long 0x00000078    ;disable cache & MPU, enable TCMs

  PER.Set C15:0x019 %Long 0x00100012    ;set DTCM size and location
  PER.Set C15:0x119 %Long 0x00000012    ;set ITCM size

  if "&loadrgn"=="sqi"
  (
    ;
    ; Reset SQI memory
    ;
    D.S UD:(&sqiregbase+0x00) %LE %LONG 0x01030100
    wait 1ms
    D.S UD:(&sqiregbase+0x00) %LE %LONG 0x010301f5
    wait 1ms
    D.S UD:(&sqiregbase+0x0c) %LE %LONG 0x01000000
    wait 1ms
  )

  if "&resetclk"=="true"
  (
    ;
    ; Reset to Ring clock
    ;
    per.set.field d:(&prccbase+0x4c) %LONG 0x00E00000 0x6
    per.set.field d:(&prccbase+0x4c) %LONG 0x01000000 0x1
    wait 1ms
    per.set.field d:(&prccbase+0x4c) %LONG 0x00000800 0x0
    wait 1ms
    per.set.field d:(&prccbase+0x50) %LONG 0x00018000 0x0
    wait 1ms

    ;
    ; Disable LDO2
    ;
    &romver=v.value(*((unsigned int *)0x30003ff8))
    &romver=&romver>>8>>8>>8>>4
    if &romver<3
    (
      per.set.field d:(&prccbckbase) %LONG 0x00200000 0x0
    )
    else
    (
      per.set.field d:(&prccbckbase) %LONG 0x00200000 0x1
    )
    wait 1ms
  )
  else
  (
    ;
    ; Enable LDO2
    ;
    &romver=v.value(*((unsigned int *)0x30003ff8))
    &romver=&romver>>8>>8>>8>>4
    if &romver<3
    (
      per.set.field d:(&prccbckbase) %LONG 0x00200000 0x1
    )
    else
    (
      per.set.field d:(&prccbckbase) %LONG 0x00200000 0x0
    )
    wait 1ms

    ;
    ; Switch to TCXO
    ;
    per.set.field d:(&prccbase+0x50) %LONG 0x00018000 0x3
    wait 1ms
    per.set.field d:(&prccbase+0x4c) %LONG 0x00000800 0x1
    wait 1ms
    per.set.field d:(&prccbase+0x4c) %LONG 0x00E00000 0x2
    per.set.field d:(&prccbase+0x4c) %LONG 0x01000000 0x1
    wait 1ms

    SYStem.jtagClock 4MHz
  )
)

